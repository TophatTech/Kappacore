/*            
 *            DRAW FUNCTIONS
 *             
 *          DRAW VARIOUS SHAPES
 *       DRAW FROM BITMAP VARIABLES
 *        DYNAMIC COLOR MANAGEMENT
 */

/* General variables */

/*Lookup Table To Convert 256 Color to RGB888*/
static const uint16_t PROGMEM lookupTable[256] = {
    0x0000, 0x000a, 0x0015, 0x001f, 0x0120, 0x012a, 0x0135, 0x013f, 
    0x0240, 0x024a, 0x0255, 0x025f, 0x0360, 0x036a, 0x0375, 0x037f, 
    0x0480, 0x048a, 0x0495, 0x049f, 0x05a0, 0x05aa, 0x05b5, 0x05bf, 
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    0xfec0, 0xfeca, 0xfed5, 0xfedf, 0xffe0, 0xffea, 0xfff5, 0xffff 
};


void drawImg(const uint8_t PROGMEM imgVar[], int lengthImg, byte xVal, byte yVal){
  /*
   * First bit should indicate width.
   * Use Decimal 256 color conversion
   * 
   */
  int ii = 0;
  int posX = xVal;
  int posY = yVal;
  for(ii=1; ii<lengthImg;ii++){
    tft.drawPixel(posX,posY,uint16_t(lookupTable[imgVar[ii]]));
    posX++;
    if(posX>=imgVar[0]){posX=0;posY++;}
  }
}





 void draw_controls(int style){
  tft.setFont();
  tft.setTextSize(1);
  tft.fillRect(0,149,128,15,ST7735_BLACK);
  switch (style) {
    case 1:
      //Horizontal Menu
      tft.fillCircle(6,154,5,ST7735_BLUE);
      tft.setCursor(8, 151);
      tft.setTextColor(ST7735_WHITE);
      tft.print(" ENT");
      
      tft.fillCircle(42,154,5,ST7735_YELLOW);
      tft.setCursor(44, 151);
      tft.setTextColor(ST7735_WHITE);
      tft.print(" BCK");

      tft.fillCircle(77,154,5,ST7735_GREEN);
      tft.setCursor(79, 151);
      tft.setTextColor(ST7735_WHITE);
      tft.print(" LF");

      tft.fillCircle(106,154,5,ST7735_RED);
      tft.setCursor(108, 151);
      tft.setTextColor(ST7735_WHITE);
      tft.print(" RT");
      break;
    case 2:
      //Vertical Menu
      tft.fillCircle(6,154,5,ST7735_BLUE);
      tft.setCursor(8, 151);
      tft.setTextColor(ST7735_WHITE);
      tft.print(" UP");
      
      tft.fillCircle(36,154,5,ST7735_YELLOW);
      tft.setCursor(38, 151);
      tft.setTextColor(ST7735_WHITE);
      tft.print(" DN");

      tft.fillCircle(66,154,5,ST7735_GREEN);
      tft.setCursor(68, 151);
      tft.setTextColor(ST7735_WHITE);
      tft.print(" ENT");

      tft.fillCircle(100,154,5,ST7735_RED);
      tft.setCursor(102, 151);
      tft.setTextColor(ST7735_WHITE);
      tft.print(" BCK");
      break;
    case 3:
      //Menu Progression
      tft.fillCircle(40,154,5,ST7735_RED);
      tft.setCursor(45, 151);
      tft.setTextColor(ST7735_WHITE);
      tft.print(" CONTINUE");
      break;
    default: 
      // Default - U/D/L/R
      tft.fillCircle(6,154,5,ST7735_BLUE);
      tft.setCursor(8, 151);
      tft.setTextColor(ST7735_WHITE);
      tft.print(" UP");
      
      tft.fillCircle(38,154,5,ST7735_YELLOW);
      tft.setCursor(40, 151);
      tft.setTextColor(ST7735_WHITE);
      tft.print(" DN");

      tft.fillCircle(72,154,5,ST7735_GREEN);
      tft.setCursor(74, 151);
      tft.setTextColor(ST7735_WHITE);
      tft.print(" LF");

      tft.fillCircle(106,154,5,ST7735_RED);
      tft.setCursor(108, 151);
      tft.setTextColor(ST7735_WHITE);
      tft.print(" RT");
    break;
  }

}
